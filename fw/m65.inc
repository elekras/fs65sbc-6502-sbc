; ****** m65 monitor for fs65sbc *******
; include file for calling m65 functions
; by F. Sturman  fabio.sturman@gmail.com
; 21:38:37 19.03.2025
mcld .equ $E400
mwrm .equ $F35D
mconr .equ $E619
mconw .equ $E64C
mcont .equ $E61C
msdr .equ $ED25
msdw .equ $EDB6
msdi .equ $EBA3
msdll .equ $ED17
msdlh .equ $ED1E
mgets .equ $E836
mputs .equ $E88F
mputb .equ $E8C8
mputw .equ $E8A3
mputsp .equ $E8AC
mputcl .equ $E8BB
mrtcr .equ $F4E1
mrtcw .equ $F558
mpmur .equ $F433
mpmuw .equ $F422
mi2cini .equ $E9D5
mi2cstr .equ $EA56
mi2cstp .equ $EA5F
mi2cack .equ $EA66
mi2cnak .equ $EA6E
mi2cwrt .equ $E9DB
mi2crea .equ $EA20
mrinc .equ $E988
mrdec .equ $E98F
mradd .equ $E99C
mrsub .equ $E9AA
mrcmp .equ $E9B8
mrequ .equ $E9C5
mrzer .equ $E997
mr0 .equ $E9D0
msw16 .equ $E4FD
mtimr .equ $E7C0
mtbrk .equ $FDA2
mdhms .equ $E97A
mtoupc .equ $E96F
mbuz .equ $E77B
mcfr .equ $EED9
mcfw .equ $EF0A
mcfi .equ $EEA6
mcfll .equ $EF61
mcflh .equ $EF68
mbtsdw .equ $F753
mbtcfw .equ $F738
